/**
 * @file test_dashboard_slot.cc
 * @brief Host tests for the real dashboard_slot translation unit.
 *
 * Copyright (c) 2026 NOTE4C poulailler dashboard contributors.
 * SPDX-License-Identifier: MIT
 *
 * This links main/common/dashboard_slot.cc itself. It is not a Python model of
 * the state machine and not a C++ re-implementation of it: if the firmware
 * logic changes, these tests exercise the changed logic or stop compiling.
 *
 * All fixtures are deterministic. Frames are generated by a fixed 32-bit LCG
 * from a hardcoded seed, so a failure reproduces exactly.
 */

#include "common/dashboard_slot.h"

#include <cstdio>
#include <cstring>
#include <cstdlib>
#include <string>
#include <vector>

using namespace dashboard;

// ------------------------------------------------------------ mini harness --

static int g_checks = 0;
static int g_failures = 0;
static const char* g_current_test = "";

static void Check(bool cond, const char* expr, int line) {
    ++g_checks;
    if (!cond) {
        ++g_failures;
        std::printf("  FAIL [%s:%d] %s\n", g_current_test, line, expr);
    }
}

#define CHECK(expr) Check((expr), #expr, __LINE__)

#define RUN(fn)                                \
    do {                                       \
        g_current_test = #fn;                  \
        const int before = g_failures;         \
        fn();                                  \
        std::printf("%-46s %s\n", #fn,         \
                    (g_failures == before) ? "ok" : "FAILED"); \
    } while (0)

// ------------------------------------------------------- fault-injecting IO --

/**
 * @brief Memory-backed SlotIo that can lie the way flash lies.
 *
 * The interesting failure is not "write returned an error". It is "write
 * returned success but only part of the data reached the medium", which is
 * what a power cut mid-write looks like to the next boot.
 */
class FakeSlotIo : public SlotIo {
public:
    std::vector<uint8_t> slot[kSlotCount];
    bool slot_present[kSlotCount] = {false, false};

    // Fault controls.
    bool fail_write = false;          ///< WriteSlot returns false.
    size_t truncate_write_at = kNoTruncate;  ///< Persist only this many bytes, still return true.
    bool fail_read = false;           ///< ReadSlot returns -1.
    int write_calls = 0;
    int last_write_slot = -1;

    static constexpr size_t kNoTruncate = static_cast<size_t>(-1);

    int ReadSlot(int s, uint8_t* buf, size_t max) override {
        if (fail_read) return -1;
        if (s < 0 || s >= kSlotCount || !slot_present[s]) return 0;
        const size_t n = slot[s].size() < max ? slot[s].size() : max;
        std::memcpy(buf, slot[s].data(), n);
        return static_cast<int>(n);
    }

    bool WriteSlot(int s, const uint8_t* data, size_t len) override {
        ++write_calls;
        last_write_slot = s;
        if (fail_write) return false;
        const size_t n = (truncate_write_at == kNoTruncate) ? len
                       : (truncate_write_at < len ? truncate_write_at : len);
        slot[s].assign(data, data + n);
        slot_present[s] = true;
        return true;
    }

    void Corrupt(int s, size_t offset, uint8_t xor_mask) {
        if (offset < slot[s].size()) slot[s][offset] ^= xor_mask;
    }
};

// --------------------------------------------------------------- fixtures --

/// Deterministic pseudo-random frame. Same seed always yields the same bytes.
static std::vector<uint8_t> MakeFrame(uint32_t seed, size_t len = kFrameBytes) {
    std::vector<uint8_t> v(len);
    uint32_t s = seed ? seed : 1u;
    for (size_t i = 0; i < len; ++i) {
        s = s * 1664525u + 1013904223u;   // Numerical Recipes LCG, fixed constants
        v[i] = static_cast<uint8_t>((s >> 24) & 0xff);
    }
    return v;
}

static std::string Hex(const uint8_t* p, size_t n) {
    static const char* d = "0123456789abcdef";
    std::string out;
    for (size_t i = 0; i < n; ++i) {
        out.push_back(d[p[i] >> 4]);
        out.push_back(d[p[i] & 0xf]);
    }
    return out;
}

// ------------------------------------------------------------ SHA-256 KATs --

// If our SHA-256 is wrong, every checksum in the system is self-consistently
// wrong and every other test still passes. These are the FIPS 180-4 vectors.
static void test_sha256_known_answers() {
    struct Vec { const char* in; const char* out; };
    const Vec vecs[] = {
        {"", "e3b0c44298fc1c149afbf4c8996fb92427ae41e4649b934ca495991b7852b855"},
        {"abc", "ba7816bf8f01cfea414140de5dae2223b00361a396177a9cb410ff61f20015ad"},
        {"abcdbcdecdefdefgefghfghighijhijkijkljklmklmnlmnomnopnopq",
         "248d6a61d20638b8e5c026930c3e6039a33ce45964ff2167f6ecedd419db06c1"},
    };
    for (const auto& v : vecs) {
        uint8_t d[kShaBytes];
        Sha256(reinterpret_cast<const uint8_t*>(v.in), std::strlen(v.in), d);
        CHECK(Hex(d, kShaBytes) == std::string(v.out));
    }

    // One million 'a' characters -> the classic long vector. Exercises the
    // multi-block path far past any buffer boundary.
    std::vector<uint8_t> million(1000000, 'a');
    uint8_t d[kShaBytes];
    Sha256(million.data(), million.size(), d);
    CHECK(Hex(d, kShaBytes) ==
          std::string("cdc76e5c9914fb9281a1c7e284d73e67f1809a48a497200e046d39ccc7112cd0"));
}

/// The padding tail has a one-block and a two-block form; the switch happens at
/// 56 bytes within the final block. Walk every boundary rather than trusting it.
static void test_sha256_padding_boundaries() {
    const size_t lens[] = {0, 1, 54, 55, 56, 57, 63, 64, 65, 119, 120, 127, 128, 129};
    for (size_t len : lens) {
        std::vector<uint8_t> buf = MakeFrame(0xC0FFEEu, len);
        uint8_t a[kShaBytes];
        Sha256(buf.data(), len, a);

        // Cross-check against an independent incremental path: hashing the same
        // bytes must not depend on how much slack the caller's buffer has.
        std::vector<uint8_t> padded = buf;
        padded.resize(len + 64, 0xAB);
        uint8_t b[kShaBytes];
        Sha256(padded.data(), len, b);
        CHECK(std::memcmp(a, b, kShaBytes) == 0);
    }
}

static void test_crc32_known_answer() {
    const char* s = "123456789";
    CHECK(Crc32(reinterpret_cast<const uint8_t*>(s), 9) == 0xCBF43926u);
    CHECK(Crc32(reinterpret_cast<const uint8_t*>(""), 0) == 0u);
}

static void test_constant_time_equals() {
    uint8_t a[4] = {1, 2, 3, 4};
    uint8_t b[4] = {1, 2, 3, 4};
    uint8_t c[4] = {1, 2, 3, 5};
    uint8_t d[4] = {9, 2, 3, 4};
    CHECK(ConstantTimeEquals(a, b, 4));
    CHECK(!ConstantTimeEquals(a, c, 4));
    CHECK(!ConstantTimeEquals(a, d, 4));
}

// ------------------------------------------------------- basic store cycle --

static void test_empty_store_has_no_frame() {
    FakeSlotIo io;
    std::vector<uint8_t> slot_scratch(kRecordBytes);
    DashboardSlot slot(&io, slot_scratch.data(), slot_scratch.size());
    CHECK(!slot.Load());
    CHECK(!slot.has_frame());
    CHECK(slot.active_slot() == -1);
    CHECK(slot.active_seq() == 0);
    CHECK(slot.active_sha() == nullptr);

    std::vector<uint8_t> out(kFrameBytes);
    CHECK(!slot.ReadFrame(out.data()));
}

static void test_store_then_read_roundtrip() {
    FakeSlotIo io;
    std::vector<uint8_t> slot_scratch(kRecordBytes);
    DashboardSlot slot(&io, slot_scratch.data(), slot_scratch.size());
    slot.Load();

    auto f1 = MakeFrame(1);
    CHECK(slot.Store(f1.data(), f1.size(), 1757500000u) == StoreResult::kOk);
    CHECK(slot.has_frame());
    CHECK(slot.active_seq() == 1);
    CHECK(slot.active_source_epoch() == 1757500000u);

    std::vector<uint8_t> out(kFrameBytes);
    CHECK(slot.ReadFrame(out.data()));
    CHECK(out == f1);

    // A fresh instance over the same storage must reach the same conclusion:
    // this is the reboot path.
    std::vector<uint8_t> reboot_scratch(kRecordBytes);
    DashboardSlot reboot(&io, reboot_scratch.data(), reboot_scratch.size());
    CHECK(reboot.Load());
    CHECK(reboot.active_seq() == 1);
    std::vector<uint8_t> out2(kFrameBytes);
    CHECK(reboot.ReadFrame(out2.data()));
    CHECK(out2 == f1);
}

static void test_duplicate_payload_is_not_rewritten() {
    FakeSlotIo io;
    std::vector<uint8_t> slot_scratch(kRecordBytes);
    DashboardSlot slot(&io, slot_scratch.data(), slot_scratch.size());
    slot.Load();

    auto f1 = MakeFrame(2);
    CHECK(slot.Store(f1.data(), f1.size(), 100) == StoreResult::kOk);
    const int writes_after_first = io.write_calls;

    CHECK(slot.Store(f1.data(), f1.size(), 200) == StoreResult::kDuplicate);
    // Dedup must be real: no flash write at all, not just a skipped render.
    CHECK(io.write_calls == writes_after_first);
    CHECK(slot.active_seq() == 1);
}

static void test_slots_alternate_and_keep_previous() {
    FakeSlotIo io;
    std::vector<uint8_t> slot_scratch(kRecordBytes);
    DashboardSlot slot(&io, slot_scratch.data(), slot_scratch.size());
    slot.Load();

    auto f1 = MakeFrame(11);
    auto f2 = MakeFrame(22);
    auto f3 = MakeFrame(33);

    CHECK(slot.Store(f1.data(), f1.size(), 1) == StoreResult::kOk);
    CHECK(slot.active_slot() == 0);
    CHECK(slot.Store(f2.data(), f2.size(), 2) == StoreResult::kOk);
    CHECK(slot.active_slot() == 1);
    CHECK(slot.active_seq() == 2);
    CHECK(slot.Store(f3.data(), f3.size(), 3) == StoreResult::kOk);
    CHECK(slot.active_slot() == 0);
    CHECK(slot.active_seq() == 3);

    // Storage stays bounded at exactly two records no matter how many updates.
    CHECK(io.slot[0].size() == kRecordBytes);
    CHECK(io.slot[1].size() == kRecordBytes);
}

static void test_bad_lengths_rejected() {
    FakeSlotIo io;
    std::vector<uint8_t> slot_scratch(kRecordBytes);
    DashboardSlot slot(&io, slot_scratch.data(), slot_scratch.size());
    slot.Load();

    auto ok = MakeFrame(5);
    CHECK(slot.Store(ok.data(), kFrameBytes - 1, 0) == StoreResult::kBadLength);
    CHECK(slot.Store(ok.data(), kFrameBytes + 1, 0) == StoreResult::kBadLength);
    CHECK(slot.Store(ok.data(), 0, 0) == StoreResult::kBadLength);
    CHECK(io.write_calls == 0);
    CHECK(!slot.has_frame());
}

static void test_declared_sha_mismatch_rejected() {
    FakeSlotIo io;
    std::vector<uint8_t> slot_scratch(kRecordBytes);
    DashboardSlot slot(&io, slot_scratch.data(), slot_scratch.size());
    slot.Load();

    auto f1 = MakeFrame(7);
    uint8_t sha[kShaBytes];
    Sha256(f1.data(), f1.size(), sha);
    CHECK(slot.Store(f1.data(), f1.size(), 0, sha) == StoreResult::kOk);

    // Same declared digest, different bytes: the transfer was corrupted.
    auto f2 = MakeFrame(8);
    const int writes = io.write_calls;
    CHECK(slot.Store(f2.data(), f2.size(), 0, sha) == StoreResult::kBadLength);
    CHECK(io.write_calls == writes);   // nothing persisted
    CHECK(slot.active_seq() == 1);     // previous frame still active

    std::vector<uint8_t> out(kFrameBytes);
    CHECK(slot.ReadFrame(out.data()));
    CHECK(out == f1);
}

// ------------------------------------------------------ power-loss sweeps --

/**
 * Cut power at every byte offset of the second write and confirm the next boot
 * always finds a complete frame. This is the central claim of the design, so it
 * is tested by exhaustive sweep rather than at a few hand-picked offsets.
 */
static void test_power_loss_during_write_never_tears() {
    auto f1 = MakeFrame(101);
    auto f2 = MakeFrame(202);

    // Step through the whole record. Step 61 is coprime with the record size so
    // offsets land at varied positions inside header, sha field and payload.
    for (size_t cut = 0; cut < kRecordBytes; cut += 61) {
        FakeSlotIo io;
        {
            std::vector<uint8_t> setup_scratch(kRecordBytes);
            DashboardSlot setup(&io, setup_scratch.data(), setup_scratch.size());
            setup.Load();
            if (setup.Store(f1.data(), f1.size(), 1) != StoreResult::kOk) {
                CHECK(false);
                return;
            }
        }

        {
            std::vector<uint8_t> live_scratch(kRecordBytes);
            DashboardSlot live(&io, live_scratch.data(), live_scratch.size());
            live.Load();
            io.truncate_write_at = cut;
            // The result may be kVerifyFailed; what matters is what survives.
            live.Store(f2.data(), f2.size(), 2);
        }

        // Reboot.
        io.truncate_write_at = FakeSlotIo::kNoTruncate;
        std::vector<uint8_t> after_scratch(kRecordBytes);
        DashboardSlot after(&io, after_scratch.data(), after_scratch.size());
        const bool loaded = after.Load();
        if (!loaded) {
            std::printf("  cut=%zu lost the frame entirely\n", cut);
            CHECK(false);
            continue;
        }
        std::vector<uint8_t> out(kFrameBytes);
        if (!after.ReadFrame(out.data())) {
            std::printf("  cut=%zu active frame unreadable\n", cut);
            CHECK(false);
            continue;
        }
        // Either the old or the new frame, never a mixture of the two.
        const bool is_old = (out == f1);
        const bool is_new = (out == f2);
        if (!is_old && !is_new) {
            std::printf("  cut=%zu produced a torn frame\n", cut);
        }
        CHECK(is_old || is_new);
    }
}

/// A truncated write that the filesystem reported as successful must be caught
/// by read-back verification, and must not become the active frame.
static void test_short_write_is_caught_by_readback() {
    FakeSlotIo io;
    std::vector<uint8_t> slot_scratch(kRecordBytes);
    DashboardSlot slot(&io, slot_scratch.data(), slot_scratch.size());
    slot.Load();

    auto f1 = MakeFrame(301);
    CHECK(slot.Store(f1.data(), f1.size(), 1) == StoreResult::kOk);

    auto f2 = MakeFrame(302);
    io.truncate_write_at = kRecordBytes - 10;
    CHECK(slot.Store(f2.data(), f2.size(), 2) == StoreResult::kVerifyFailed);
    io.truncate_write_at = FakeSlotIo::kNoTruncate;

    // Still serving the old frame, and still saying so.
    CHECK(slot.active_seq() == 1);
    std::vector<uint8_t> out(kFrameBytes);
    CHECK(slot.ReadFrame(out.data()));
    CHECK(out == f1);
}

static void test_write_error_leaves_previous_active() {
    FakeSlotIo io;
    std::vector<uint8_t> slot_scratch(kRecordBytes);
    DashboardSlot slot(&io, slot_scratch.data(), slot_scratch.size());
    slot.Load();

    auto f1 = MakeFrame(401);
    CHECK(slot.Store(f1.data(), f1.size(), 1) == StoreResult::kOk);

    auto f2 = MakeFrame(402);
    io.fail_write = true;
    CHECK(slot.Store(f2.data(), f2.size(), 2) == StoreResult::kWriteFailed);
    io.fail_write = false;

    CHECK(slot.active_seq() == 1);
    std::vector<uint8_t> out(kFrameBytes);
    CHECK(slot.ReadFrame(out.data()));
    CHECK(out == f1);
}

// ------------------------------------------------- corruption and recovery --

/// Bit rot in the newer slot must fall back to the older complete frame rather
/// than showing nothing or showing garbage.
static void test_corrupt_active_falls_back_to_older_slot() {
    FakeSlotIo io;
    {
        std::vector<uint8_t> slot_scratch(kRecordBytes);
        DashboardSlot slot(&io, slot_scratch.data(), slot_scratch.size());
        slot.Load();
        auto f1 = MakeFrame(501);
        auto f2 = MakeFrame(502);
        CHECK(slot.Store(f1.data(), f1.size(), 1) == StoreResult::kOk);
        CHECK(slot.Store(f2.data(), f2.size(), 2) == StoreResult::kOk);
        CHECK(slot.active_slot() == 1);
    }

    io.Corrupt(1, kHeaderBytes + 12345, 0x01);   // one flipped bit in the payload

    std::vector<uint8_t> after_scratch(kRecordBytes);
    DashboardSlot after(&io, after_scratch.data(), after_scratch.size());
    CHECK(after.Load());
    CHECK(after.active_slot() == 0);
    CHECK(after.active_seq() == 1);
    std::vector<uint8_t> out(kFrameBytes);
    CHECK(after.ReadFrame(out.data()));
    CHECK(out == MakeFrame(501));
}

static void test_corrupt_header_fields_invalidate_slot() {
    struct Case { const char* what; size_t offset; };
    const Case cases[] = {
        {"magic", 0},
        {"version", 8},
        {"seq", 12},
        {"payload_len", 16},
        {"sha", 24},
        {"source_epoch", 56},
        {"header_crc", 60},
    };

    for (const auto& c : cases) {
        FakeSlotIo io;
        {
            std::vector<uint8_t> slot_scratch(kRecordBytes);
            DashboardSlot slot(&io, slot_scratch.data(), slot_scratch.size());
            slot.Load();
            auto f1 = MakeFrame(601);
            CHECK(slot.Store(f1.data(), f1.size(), 7) == StoreResult::kOk);
        }
        io.Corrupt(0, c.offset, 0x40);

        std::vector<uint8_t> after_scratch(kRecordBytes);
        DashboardSlot after(&io, after_scratch.data(), after_scratch.size());
        const bool loaded = after.Load();
        if (loaded) {
            std::printf("  corrupting %s still validated\n", c.what);
        }
        CHECK(!loaded);
        CHECK(!after.has_frame());
    }
}

static void test_both_slots_corrupt_reports_no_frame() {
    FakeSlotIo io;
    {
        std::vector<uint8_t> slot_scratch(kRecordBytes);
        DashboardSlot slot(&io, slot_scratch.data(), slot_scratch.size());
        slot.Load();
        auto f1 = MakeFrame(701);
        auto f2 = MakeFrame(702);
        CHECK(slot.Store(f1.data(), f1.size(), 1) == StoreResult::kOk);
        CHECK(slot.Store(f2.data(), f2.size(), 2) == StoreResult::kOk);
    }
    io.Corrupt(0, kHeaderBytes + 5, 0x80);
    io.Corrupt(1, kHeaderBytes + 5, 0x80);

    std::vector<uint8_t> after_scratch(kRecordBytes);
    DashboardSlot after(&io, after_scratch.data(), after_scratch.size());
    CHECK(!after.Load());
    CHECK(!after.has_frame());
    std::vector<uint8_t> out(kFrameBytes);
    CHECK(!after.ReadFrame(out.data()));
}

/// Reading a slot that is too short to even hold a header must be rejected
/// without reading past the buffer.
static void test_truncated_below_header_rejected() {
    FakeSlotIo io;
    {
        std::vector<uint8_t> slot_scratch(kRecordBytes);
        DashboardSlot slot(&io, slot_scratch.data(), slot_scratch.size());
        slot.Load();
        auto f1 = MakeFrame(801);
        CHECK(slot.Store(f1.data(), f1.size(), 1) == StoreResult::kOk);
    }
    io.slot[0].resize(kHeaderBytes - 1);

    std::vector<uint8_t> after_scratch(kRecordBytes);
    DashboardSlot after(&io, after_scratch.data(), after_scratch.size());
    CHECK(!after.Load());
}

/// An undersized scratch buffer must fail closed rather than write past its end.
/// The constructor cannot report an error, so every operation refuses instead.
static void test_undersized_scratch_fails_closed() {
    FakeSlotIo io;
    std::vector<uint8_t> tiny(kRecordBytes - 1);
    DashboardSlot slot(&io, tiny.data(), tiny.size());

    auto f1 = MakeFrame(950);
    CHECK(slot.Store(f1.data(), f1.size(), 1) == StoreResult::kWriteFailed);
    CHECK(io.write_calls == 0);
    CHECK(!slot.Load());
    CHECK(!slot.has_frame());

    std::vector<uint8_t> out(kFrameBytes);
    CHECK(!slot.ReadFrame(out.data()));
}

/// The store must not depend on scratch contents surviving between calls: a
/// caller sharing one buffer across instances is explicitly supported.
static void test_scratch_buffer_is_reusable_across_instances() {
    FakeSlotIo io;
    std::vector<uint8_t> shared(kRecordBytes);
    auto f1 = MakeFrame(960);

    {
        DashboardSlot a(&io, shared.data(), shared.size());
        a.Load();
        CHECK(a.Store(f1.data(), f1.size(), 1) == StoreResult::kOk);
    }
    std::memset(shared.data(), 0xA5, shared.size());   // caller reused it meanwhile

    DashboardSlot b(&io, shared.data(), shared.size());
    CHECK(b.Load());
    std::vector<uint8_t> out(kFrameBytes);
    CHECK(b.ReadFrame(out.data()));
    CHECK(out == f1);
}

static void test_read_error_reports_failure() {
    FakeSlotIo io;
    std::vector<uint8_t> slot_scratch(kRecordBytes);
    DashboardSlot slot(&io, slot_scratch.data(), slot_scratch.size());
    slot.Load();
    auto f1 = MakeFrame(901);
    CHECK(slot.Store(f1.data(), f1.size(), 1) == StoreResult::kOk);

    io.fail_read = true;
    std::vector<uint8_t> out(kFrameBytes);
    CHECK(!slot.ReadFrame(out.data()));
}

// ------------------------------------------------------- the origin flag --

/**
 * THE ORIGIN BIT SURVIVES A REBOOT, WHICH IS THE ONLY REASON IT IS IN FLASH.
 *
 * The device is asked "what is on the glass" after a deep sleep, and e-paper
 * keeps its image while nothing in RAM does. A flag remembered in a variable
 * would answer that question by guessing. This one is read back out of the
 * record's own header by a fresh instance over the same storage, which is the
 * reboot path.
 */
static void test_the_origin_flag_is_stored_and_read_back() {
    FakeSlotIo io;
    std::vector<uint8_t> slot_scratch(kRecordBytes);
    DashboardSlot slot(&io, slot_scratch.data(), slot_scratch.size());
    slot.Load();

    auto pushed = MakeFrame(11);
    CHECK(slot.Store(pushed.data(), pushed.size(), 1757500000u) == StoreResult::kOk);
    // The default, and the whole compatibility argument: a caller that does not
    // ask for a flag writes the zero every previous build wrote.
    CHECK(slot.active_flags() == 0u);
    CHECK((slot.active_flags() & kFlagOriginLocal) == 0u);

    auto composed = MakeFrame(12);
    CHECK(slot.Store(composed.data(), composed.size(), 1757500100u, nullptr,
                     kFlagOriginLocal) == StoreResult::kOk);
    CHECK((slot.active_flags() & kFlagOriginLocal) != 0u);

    std::vector<uint8_t> reboot_scratch(kRecordBytes);
    DashboardSlot reboot(&io, reboot_scratch.data(), reboot_scratch.size());
    CHECK(reboot.Load());
    CHECK(reboot.active_seq() == 2);
    CHECK((reboot.active_flags() & kFlagOriginLocal) != 0u);

    // And the older slot still says what *it* was. The two records disagree
    // because they came from different places, which is the point.
    CHECK((reboot.slot_status(0).flags & kFlagOriginLocal) == 0u);
    CHECK((reboot.slot_status(1).flags & kFlagOriginLocal) != 0u);
}

/// A record with no valid slot has no origin to report, and must not borrow
/// one: a device holding nothing is not a device holding something local.
static void test_no_frame_means_no_flags() {
    FakeSlotIo io;
    std::vector<uint8_t> slot_scratch(kRecordBytes);
    DashboardSlot slot(&io, slot_scratch.data(), slot_scratch.size());
    CHECK(!slot.Load());
    CHECK(!slot.has_frame());
    CHECK(slot.active_flags() == 0u);
}

/**
 * The flags word is inside the header CRC, so a record whose origin bit was
 * flipped in flash fails validation rather than reading as the other origin.
 * That matters: the arbitration rule acts on this bit, and a silently flipped
 * one would make the device defer to a tower frame that it composed itself.
 */
static void test_a_flipped_origin_bit_invalidates_the_record() {
    FakeSlotIo io;
    std::vector<uint8_t> slot_scratch(kRecordBytes);
    DashboardSlot slot(&io, slot_scratch.data(), slot_scratch.size());
    slot.Load();
    auto f = MakeFrame(13);
    CHECK(slot.Store(f.data(), f.size(), 1757500200u, nullptr, kFlagOriginLocal) ==
          StoreResult::kOk);
    const int active = slot.active_slot();
    CHECK(active >= 0);

    // Offset 20 is the flags word. Flip bit 0 of its first byte.
    io.Corrupt(active, 20, 0x01);

    std::vector<uint8_t> reboot_scratch(kRecordBytes);
    DashboardSlot reboot(&io, reboot_scratch.data(), reboot_scratch.size());
    CHECK(!reboot.Load());
    CHECK(!reboot.slot_status(active).valid);
}

// -------------------------------------------------------------------- main --

int main() {
    std::printf("dashboard_slot host tests (real firmware translation unit)\n\n");

    RUN(test_sha256_known_answers);
    RUN(test_sha256_padding_boundaries);
    RUN(test_crc32_known_answer);
    RUN(test_constant_time_equals);

    RUN(test_empty_store_has_no_frame);
    RUN(test_store_then_read_roundtrip);
    RUN(test_duplicate_payload_is_not_rewritten);
    RUN(test_slots_alternate_and_keep_previous);
    RUN(test_bad_lengths_rejected);
    RUN(test_declared_sha_mismatch_rejected);

    RUN(test_power_loss_during_write_never_tears);
    RUN(test_short_write_is_caught_by_readback);
    RUN(test_write_error_leaves_previous_active);

    RUN(test_corrupt_active_falls_back_to_older_slot);
    RUN(test_corrupt_header_fields_invalidate_slot);
    RUN(test_both_slots_corrupt_reports_no_frame);
    RUN(test_truncated_below_header_rejected);
    RUN(test_undersized_scratch_fails_closed);
    RUN(test_scratch_buffer_is_reusable_across_instances);
    RUN(test_read_error_reports_failure);

    RUN(test_the_origin_flag_is_stored_and_read_back);
    RUN(test_no_frame_means_no_flags);
    RUN(test_a_flipped_origin_bit_invalidates_the_record);

    std::printf("\n%d checks, %d failures\n", g_checks, g_failures);
    return g_failures == 0 ? 0 : 1;
}

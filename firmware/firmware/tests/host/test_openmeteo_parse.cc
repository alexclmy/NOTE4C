/**
 * @file test_openmeteo_parse.cc
 * @brief Host tests for the device's forecast reader.
 *
 * Copyright (c) 2026 NOTE4C poulailler dashboard contributors.
 * SPDX-License-Identifier: MIT
 *
 * These compile main/common/openmeteo_parse.cc directly.
 *
 * About the fixtures
 * ------------------
 * They are *synthesised* here, not captured from the live service. That is a
 * deliberate limitation and worth stating plainly rather than implying a
 * capture: this suite proves the reader enforces the contract it claims to
 * enforce, and it does not prove that Open-Meteo's real responses satisfy that
 * contract. The shapes are built from the documented response format and from
 * the tower's own zod schema, which does read the live service. Confirming the
 * real payload against this reader is a separate exercise that needs a network
 * the device is not allowed to touch from here.
 *
 * The refusals are the interesting half. Every one below is a document that
 * would produce a plausible-looking panel if it were accepted, which is exactly
 * why e-paper makes them worth refusing: there is no spinner on frozen ink.
 */

#include "common/openmeteo_parse.h"

#include <stdio.h>
#include <string.h>

#include <string>

using namespace weather;

// ----------------------------------------------------------- tiny harness --

static int g_checks = 0;
static int g_failures = 0;
static const char* g_current = "";

#define CHECK(cond)                                                        \
    do {                                                                   \
        ++g_checks;                                                        \
        if (!(cond)) {                                                     \
            ++g_failures;                                                  \
            printf("  FAIL %s:%d in %s: %s\n", __FILE__, __LINE__,         \
                   g_current, #cond);                                      \
        }                                                                  \
    } while (0)

#define CHECK_EQ_INT(a, b)                                                 \
    do {                                                                   \
        ++g_checks;                                                        \
        const long long va = (long long)(a);                               \
        const long long vb = (long long)(b);                               \
        if (va != vb) {                                                    \
            ++g_failures;                                                  \
            printf("  FAIL %s:%d in %s: %s == %s (%lld vs %lld)\n",        \
                   __FILE__, __LINE__, g_current, #a, #b, va, vb);         \
        }                                                                  \
    } while (0)

#define CHECK_STR(a, b)                                                    \
    do {                                                                   \
        ++g_checks;                                                        \
        if (strcmp((a), (b)) != 0) {                                       \
            ++g_failures;                                                  \
            printf("  FAIL %s:%d in %s: \"%s\" == \"%s\"\n", __FILE__,     \
                   __LINE__, g_current, (a), (b));                         \
        }                                                                  \
    } while (0)

#define RUN(fn)                                                            \
    do {                                                                   \
        g_current = #fn;                                                   \
        const int before = g_failures;                                     \
        fn();                                                              \
        printf("%-58s %s\n", #fn, g_failures == before ? "ok" : "FAILED"); \
    } while (0)

namespace {

/// 2026-09-14T12:00:00Z, the moment every test in this file treats as "now".
/// A fixed instant rather than the clock, so a test that passes today passes
/// in February. The value is cross-checked against an independent calendar
/// implementation rather than against the parser under test.
constexpr int64_t kNow = 1789387200ll;

std::string Stamp(int64_t epoch) {
    // Reverse of the parser's civil-date arithmetic, written independently so
    // the fixtures are not generated by the code they are testing.
    int64_t days = epoch / 86400;
    int64_t rem = epoch % 86400;
    if (rem < 0) {
        rem += 86400;
        --days;
    }
    int64_t z = days + 719468;
    const int64_t era = (z >= 0 ? z : z - 146096) / 146097;
    const int64_t doe = z - era * 146097;
    const int64_t yoe = (doe - doe / 1460 + doe / 36524 - doe / 146096) / 365;
    int64_t y = yoe + era * 400;
    const int64_t doy = doe - (365 * yoe + yoe / 4 - yoe / 100);
    const int64_t mp = (5 * doy + 2) / 153;
    const int64_t d = doy - (153 * mp + 2) / 5 + 1;
    const int64_t m = mp + (mp < 10 ? 3 : -9);
    y += (m <= 2);

    char buf[32];
    snprintf(buf, sizeof(buf), "%04lld-%02lld-%02lldT%02lld:%02lld",
             static_cast<long long>(y), static_cast<long long>(m),
             static_cast<long long>(d), static_cast<long long>(rem / 3600),
             static_cast<long long>((rem % 3600) / 60));
    return buf;
}

/// Options for building a response, so each test names only what it changes.
struct Build {
    int hours = 26;            ///< entries emitted, starting at `start_offset`
    int64_t start_offset = 0;  ///< seconds from kNow to the first entry
    int skip_index = -1;       ///< omit this entry entirely, to make a gap
    int null_temp_index = -1;  ///< emit null for this entry's temperature
    int null_code_index = -1;
    bool include_units = true;
    const char* unit = "\xc2\xb0""C";
    bool short_temps = false;  ///< emit one fewer temperature than times
    double temp_override = 1e9;
    int temp_override_index = -1;
};

std::string BuildResponse(const Build& b) {
    std::string times = "[";
    std::string temps = "[";
    std::string codes = "[";
    int emitted = 0;
    for (int i = 0; i < b.hours; ++i) {
        if (i == b.skip_index) continue;
        if (emitted) {
            times += ",";
            temps += ",";
            codes += ",";
        }
        times += "\"" + Stamp(kNow + b.start_offset + i * 3600ll) + "\"";

        if (i == b.null_temp_index) {
            temps += "null";
        } else if (i == b.temp_override_index) {
            char buf[32];
            snprintf(buf, sizeof(buf), "%g", b.temp_override);
            temps += buf;
        } else {
            char buf[32];
            snprintf(buf, sizeof(buf), "%.1f", 10.0 + (i % 7));
            temps += buf;
        }

        codes += (i == b.null_code_index) ? "null" : "3";
        ++emitted;
    }
    times += "]";
    if (b.short_temps) {
        temps.erase(temps.rfind(','));
    }
    temps += "]";
    codes += "]";

    std::string doc = "{\"latitude\":45.5,\"longitude\":-73.56,";
    doc += "\"generationtime_ms\":0.12,\"utc_offset_seconds\":0,";
    doc += "\"timezone\":\"UTC\",\"elevation\":36.0,";
    if (b.include_units) {
        doc += "\"hourly_units\":{\"time\":\"iso8601\",\"temperature_2m\":\"";
        doc += b.unit;
        doc += "\",\"weather_code\":\"wmo code\"},";
    }
    doc += "\"hourly\":{\"time\":" + times +
           ",\"temperature_2m\":" + temps +
           ",\"weather_code\":" + codes + "}}";
    return doc;
}

bool Parse(const std::string& doc, Forecast* out, ParseError* err = nullptr) {
    ParseError local;
    return ParseForecast(doc.data(), doc.size(), kNow, out,
                         err != nullptr ? err : &local);
}

void ExpectRefusal(const std::string& doc, const char* code) {
    Forecast f;
    ParseError err;
    const bool ok = ParseForecast(doc.data(), doc.size(), kNow, &f, &err);
    ++g_checks;
    if (ok) {
        ++g_failures;
        printf("  FAIL in %s: expected refusal %s, but it was accepted\n", g_current,
               code);
        return;
    }
    if (err.code != code) {
        ++g_failures;
        printf("  FAIL in %s: expected %s, got %s (%s)\n", g_current, code,
               err.code ? err.code : "(null)", err.detail);
    }
}

}  // namespace

// --------------------------------------------------------------- the stamp --

static void test_iso_stamps_become_utc_epochs() {
    int64_t epoch = 0;
    CHECK(ParseIso8601Utc("2026-09-14T12:00", 16, &epoch));
    CHECK_EQ_INT(epoch, kNow);
    CHECK(ParseIso8601Utc("2026-09-14T12:00:00", 19, &epoch));
    CHECK_EQ_INT(epoch, kNow);
    CHECK(ParseIso8601Utc("2026-09-14T12:00:00Z", 20, &epoch));
    CHECK_EQ_INT(epoch, kNow);
    CHECK(ParseIso8601Utc("1970-01-01T00:00", 16, &epoch));
    CHECK_EQ_INT(epoch, 0);
}

static void test_leap_days_are_real_and_non_leap_days_are_not() {
    int64_t epoch = 0;
    CHECK(ParseIso8601Utc("2024-02-29T00:00", 16, &epoch));
    CHECK(!ParseIso8601Utc("2023-02-29T00:00", 16, &epoch));
    // 2000 is a leap year, 1900 is not. A date routine that gets this wrong is
    // wrong one day in four years, which is not a thing anybody finds by
    // looking at it.
    CHECK(ParseIso8601Utc("2000-02-29T00:00", 16, &epoch));
    CHECK(!ParseIso8601Utc("1900-02-29T00:00", 16, &epoch));
}

static void test_a_stamp_with_an_offset_is_refused_not_shifted() {
    int64_t epoch = 0;
    // The request pins timezone=UTC. A reply carrying +02:00 means the service
    // ignored that, and guessing which way to shift moves an hour of weather.
    CHECK(!ParseIso8601Utc("2026-09-14T12:00+02:00", 22, &epoch));
    CHECK(!ParseIso8601Utc("2026-09-14T12:00-05:00", 22, &epoch));
}

static void test_malformed_stamps_are_refused() {
    int64_t epoch = 0;
    CHECK(!ParseIso8601Utc("2026-09-14", 10, &epoch));
    CHECK(!ParseIso8601Utc("2026/09/14T12:00", 16, &epoch));
    CHECK(!ParseIso8601Utc("20xx-09-14T12:00", 16, &epoch));
    CHECK(!ParseIso8601Utc("2026-13-01T12:00", 16, &epoch));
    CHECK(!ParseIso8601Utc("2026-09-31T12:00", 16, &epoch));
    CHECK(!ParseIso8601Utc("2026-09-14T25:00", 16, &epoch));
    CHECK(!ParseIso8601Utc("2026-09-14T12:61", 16, &epoch));
    CHECK(!ParseIso8601Utc("", 0, &epoch));
}

// ------------------------------------------------------------- the contract --

static void test_a_complete_forecast_is_accepted() {
    Forecast f;
    CHECK(Parse(BuildResponse(Build{}), &f));
    CHECK(f.valid());
    CHECK_EQ_INT(f.hour_count, 24);
    CHECK_EQ_INT(f.first_hour_epoch, kNow);
    CHECK_EQ_INT(f.fetched_epoch, kNow);
    // Temperatures cycle 10.0..16.0, so the bounds are exact rather than
    // approximately right.
    CHECK_EQ_INT(f.low_c10, 100);
    CHECK_EQ_INT(f.high_c10, 160);
}

static void test_hours_outside_the_window_are_dropped() {
    // The response carries three days; only the next 24 hours are kept.
    Build b;
    b.hours = 72;
    Forecast f;
    CHECK(Parse(BuildResponse(b), &f));
    CHECK_EQ_INT(f.hour_count, 24);
}

static void test_exactly_23_hours_is_enough() {
    // The floor of the contract: 23 entries, first within the hour, last at
    // 23 hours out.
    Build b;
    b.hours = 24;
    b.skip_index = 5;
    Forecast f;
    ParseError err;
    const bool ok = Parse(BuildResponse(b), &f, &err);
    // Skipping one entry makes a two-hour gap, which the contract refuses even
    // though the count is still 23. Both rules matter, and this pins that.
    CHECK(!ok);
    CHECK(err.code == kErrCoverage);
}

static void test_a_forecast_that_starts_too_late_is_refused() {
    Build b;
    b.start_offset = 2 * 3600;  // first entry two hours away
    ExpectRefusal(BuildResponse(b), kErrCoverage);
}

static void test_a_forecast_that_stops_short_is_refused() {
    Build b;
    b.hours = 12;  // only half a day
    ExpectRefusal(BuildResponse(b), kErrCoverage);
}

static void test_a_gap_wider_than_an_hour_is_refused() {
    Build b;
    b.hours = 30;
    b.skip_index = 10;
    ExpectRefusal(BuildResponse(b), kErrCoverage);
}

static void test_a_null_temperature_makes_a_gap_and_is_refused() {
    // The tower drops null-temperature hours; dropping one mid-window leaves a
    // two-hour gap, and a panel drawn from it would interpolate weather that
    // was never forecast.
    Build b;
    b.hours = 30;
    b.null_temp_index = 8;
    ExpectRefusal(BuildResponse(b), kErrCoverage);
}

static void test_a_null_weather_code_is_tolerated_as_unknown() {
    // A missing code costs one icon, not the forecast. The temperature is the
    // number on the panel; the sky is decoration around it.
    Build b;
    b.null_code_index = 3;
    Forecast f;
    CHECK(Parse(BuildResponse(b), &f));
    CHECK_EQ_INT(f.wmo[3], 255);
    CHECK(ConditionForWmoCode(255) == Condition::kUnknown);
}

static void test_arrays_of_different_lengths_are_refused() {
    Build b;
    b.short_temps = true;
    ExpectRefusal(BuildResponse(b), kErrLengths);
}

static void test_fahrenheit_is_refused_not_converted() {
    // The device asks for Celsius. A reply in anything else means the device
    // and the service are not talking about the same thing, and a converter
    // here would hide exactly the change worth seeing.
    Build b;
    b.unit = "\xc2\xb0""F";
    ExpectRefusal(BuildResponse(b), kErrUnits);
}

static void test_celsius_is_accepted_in_both_spellings() {
    for (const char* unit : {"\xc2\xb0""C", "C"}) {
        Build b;
        b.unit = unit;
        Forecast f;
        CHECK(Parse(BuildResponse(b), &f));
    }
}

static void test_a_response_with_no_units_block_is_accepted() {
    // The request pins the default, so an absent block is not a disagreement.
    Build b;
    b.include_units = false;
    Forecast f;
    CHECK(Parse(BuildResponse(b), &f));
}

static void test_an_implausible_temperature_is_refused() {
    Build b;
    b.temp_override_index = 4;
    b.temp_override = 500.0;  // not a temperature this planet has
    ExpectRefusal(BuildResponse(b), kErrTemperature);

    Build cold = Build{};
    cold.temp_override_index = 4;
    cold.temp_override = -200.0;
    ExpectRefusal(BuildResponse(cold), kErrTemperature);
}

static void test_a_temperature_at_the_edge_of_plausible_is_accepted() {
    Build b;
    b.temp_override_index = 4;
    b.temp_override = 59.9;
    Forecast f;
    CHECK(Parse(BuildResponse(b), &f));
    CHECK_EQ_INT(f.high_c10, 599);
}

static void test_a_duplicate_hourly_key_is_refused() {
    std::string doc = BuildResponse(Build{});
    const size_t at = doc.find("\"hourly\":");
    doc.insert(at, "\"hourly\":{\"time\":[],\"temperature_2m\":[],\"weather_code\":[]},");
    ExpectRefusal(doc, kErrDuplicate);
}

static void test_unknown_root_and_hourly_fields_are_skipped() {
    // The opposite of the profile's rule, deliberately: this is a third-party
    // response that may legitimately grow fields, and refusing those would mean
    // the panel goes dark the day Open-Meteo adds one.
    std::string doc = BuildResponse(Build{});
    const size_t at = doc.find("\"hourly\":{");
    doc.insert(at, "\"daily\":{\"sunrise\":[\"x\"]},\"new_field\":[1,2,3],");
    const size_t inner = doc.rfind("\"time\":");
    doc.insert(inner, "\"apparent_temperature\":[1,2],");
    Forecast f;
    CHECK(Parse(doc, &f));
    CHECK(f.valid());
}

// --------------------------------------------------------- the bad documents --

static void test_html_is_refused() {
    // A captive portal or an error page, which is what a device on a hotel
    // network actually receives.
    ExpectRefusal("<!DOCTYPE html><html><body>Not found</body></html>", kErrShape);
}

static void test_an_empty_body_is_refused() {
    ExpectRefusal("", kErrShape);
}

static void test_a_json_error_object_is_refused() {
    ExpectRefusal(R"({"error":true,"reason":"Cannot initialize WeatherVariable"})",
                  kErrShape);
}

static void test_every_truncation_of_a_good_response_is_refused() {
    // A connection that dropped part way through is the common failure, and a
    // truncated JSON array must never read as a shorter forecast. Under ASan
    // this also proves nothing reads off the end.
    const std::string full = BuildResponse(Build{});
    for (size_t cut = 0; cut < full.size(); cut += 7) {
        Forecast f;
        ParseError err;
        if (ParseForecast(full.data(), cut, kNow, &f, &err)) {
            ++g_failures;
            printf("  FAIL in %s: prefix of %zu bytes was accepted\n", g_current, cut);
        }
        ++g_checks;
    }
    Forecast whole;
    CHECK(Parse(full, &whole));
}

static void test_a_body_past_the_size_bound_is_refused_before_parsing() {
    const std::string huge(kMaxResponseBytes + 1, ' ');
    ExpectRefusal(huge, kErrTooLarge);
}

static void test_a_trailing_comma_is_refused() {
    std::string doc = BuildResponse(Build{});
    const size_t at = doc.rfind("]}}");
    doc.insert(at, ",");
    ExpectRefusal(doc, kErrShape);
}

// ------------------------------------------------------------- wmo mapping --

static void test_wmo_codes_map_to_the_towers_conditions() {
    CHECK(ConditionForWmoCode(0) == Condition::kSunny);
    CHECK(ConditionForWmoCode(1) == Condition::kPartlyCloudy);
    CHECK(ConditionForWmoCode(2) == Condition::kPartlyCloudy);
    CHECK(ConditionForWmoCode(3) == Condition::kCloudy);
    CHECK(ConditionForWmoCode(45) == Condition::kFog);
    CHECK(ConditionForWmoCode(48) == Condition::kFog);
    CHECK(ConditionForWmoCode(61) == Condition::kRainy);
    CHECK(ConditionForWmoCode(82) == Condition::kRainy);
    CHECK(ConditionForWmoCode(71) == Condition::kSnowy);
    CHECK(ConditionForWmoCode(86) == Condition::kSnowy);
    CHECK(ConditionForWmoCode(95) == Condition::kThunder);
    CHECK(ConditionForWmoCode(99) == Condition::kThunder);
    CHECK(ConditionForWmoCode(4) == Condition::kUnknown);
    CHECK(ConditionForWmoCode(-1) == Condition::kUnknown);
    CHECK_STR(ConditionName(Condition::kThunder), "lightning-rainy");
}

// ------------------------------------------------------------- the cache --

static void test_a_forecast_survives_the_cache_encoding() {
    Forecast f;
    CHECK(Parse(BuildResponse(Build{}), &f));

    uint8_t buf[kEncodedForecastBytes];
    const size_t n = EncodeForecast(f, buf, sizeof(buf));
    CHECK_EQ_INT(n, kEncodedForecastBytes);

    Forecast back;
    CHECK(DecodeForecast(buf, n, &back));
    CHECK_EQ_INT(back.fetched_epoch, f.fetched_epoch);
    CHECK_EQ_INT(back.first_hour_epoch, f.first_hour_epoch);
    CHECK_EQ_INT(back.hour_count, f.hour_count);
    CHECK_EQ_INT(back.low_c10, f.low_c10);
    CHECK_EQ_INT(back.high_c10, f.high_c10);
    CHECK(memcmp(back.temp_c10, f.temp_c10, sizeof(f.temp_c10)) == 0);
    CHECK(memcmp(back.wmo, f.wmo, sizeof(f.wmo)) == 0);
}

static void test_negative_temperatures_survive_the_encoding() {
    // Sign matters and the encoding is hand-rolled, so a January forecast is
    // worth one test of its own.
    Forecast f;
    f.hour_count = kMaxHours;
    for (size_t i = 0; i < kMaxHours; ++i) f.temp_c10[i] = static_cast<int16_t>(-200 - i);
    f.low_c10 = -223;
    f.high_c10 = -200;
    uint8_t buf[kEncodedForecastBytes];
    CHECK_EQ_INT(EncodeForecast(f, buf, sizeof(buf)), kEncodedForecastBytes);
    Forecast back;
    CHECK(DecodeForecast(buf, sizeof(buf), &back));
    CHECK_EQ_INT(back.low_c10, -223);
    CHECK_EQ_INT(back.high_c10, -200);
    CHECK_EQ_INT(back.temp_c10[23], -223);
}

static void test_the_cache_record_fits_its_slot_budget() {
    // The plan budgets 4 KB for this record; the encoding is under 100 bytes.
    CHECK(kEncodedForecastBytes <= 4096);
}

static void test_a_corrupt_cache_record_is_refused() {
    Forecast f;
    CHECK(Parse(BuildResponse(Build{}), &f));
    uint8_t buf[kEncodedForecastBytes];
    CHECK(EncodeForecast(f, buf, sizeof(buf)) > 0);

    Forecast back;
    buf[0] = 'X';
    CHECK(!DecodeForecast(buf, sizeof(buf), &back));
    buf[0] = 'W';
    buf[3] = 99;  // a version this build does not know
    CHECK(!DecodeForecast(buf, sizeof(buf), &back));
    buf[3] = 1;
    CHECK(!DecodeForecast(buf, sizeof(buf) - 1, &back));  // truncated
}

static void test_encoding_refuses_a_buffer_that_is_too_small() {
    Forecast f;
    uint8_t buf[8];
    CHECK_EQ_INT(EncodeForecast(f, buf, sizeof(buf)), 0);
}

int main() {
    RUN(test_iso_stamps_become_utc_epochs);
    RUN(test_leap_days_are_real_and_non_leap_days_are_not);
    RUN(test_a_stamp_with_an_offset_is_refused_not_shifted);
    RUN(test_malformed_stamps_are_refused);

    RUN(test_a_complete_forecast_is_accepted);
    RUN(test_hours_outside_the_window_are_dropped);
    RUN(test_exactly_23_hours_is_enough);
    RUN(test_a_forecast_that_starts_too_late_is_refused);
    RUN(test_a_forecast_that_stops_short_is_refused);
    RUN(test_a_gap_wider_than_an_hour_is_refused);
    RUN(test_a_null_temperature_makes_a_gap_and_is_refused);
    RUN(test_a_null_weather_code_is_tolerated_as_unknown);
    RUN(test_arrays_of_different_lengths_are_refused);
    RUN(test_fahrenheit_is_refused_not_converted);
    RUN(test_celsius_is_accepted_in_both_spellings);
    RUN(test_a_response_with_no_units_block_is_accepted);
    RUN(test_an_implausible_temperature_is_refused);
    RUN(test_a_temperature_at_the_edge_of_plausible_is_accepted);
    RUN(test_a_duplicate_hourly_key_is_refused);
    RUN(test_unknown_root_and_hourly_fields_are_skipped);

    RUN(test_html_is_refused);
    RUN(test_an_empty_body_is_refused);
    RUN(test_a_json_error_object_is_refused);
    RUN(test_every_truncation_of_a_good_response_is_refused);
    RUN(test_a_body_past_the_size_bound_is_refused_before_parsing);
    RUN(test_a_trailing_comma_is_refused);

    RUN(test_wmo_codes_map_to_the_towers_conditions);

    RUN(test_a_forecast_survives_the_cache_encoding);
    RUN(test_negative_temperatures_survive_the_encoding);
    RUN(test_the_cache_record_fits_its_slot_budget);
    RUN(test_a_corrupt_cache_record_is_refused);
    RUN(test_encoding_refuses_a_buffer_that_is_too_small);

    printf("\n%d checks, %d failures\n", g_checks, g_failures);
    return g_failures == 0 ? 0 : 1;
}
